## app/boards/my_board/board.yml
```yaml
board:
  name: my_board
  full_name: My Boards example
  vendor: Juan
  socs:
  - name: nrf52832
```

## app/boards/my_board_2/Kconfig.defconfig
```kconfig
if BOARD_MY_BOARD_2

config HW_STACK_PROTECTION
	default ARCH_HAS_STACK_PROTECTION

endif # BOARD_MY_BOARD_2
```

## app/boards/my_board_2/board.yml
```yaml
board:
  name: my_board_2
  full_name: My Board 2
  vendor: Juan
  socs:
  - name: nrf52832
```
