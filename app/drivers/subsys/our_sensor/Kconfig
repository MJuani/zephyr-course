## app/drivers/subsys/our_sensor/Kconfig
```kconfig
menuconfig OUR_SENSOR
	bool "enable our sensor"
	default y
	depends on DT_HAS_OUR_SENSOR_ENABLED
	select GPIO
	help
	  Enable our sensor driver
```
